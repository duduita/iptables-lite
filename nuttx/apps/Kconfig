## nuttx/apps/examples/iplite/Kconfig
```kconfig
#
# For a description of the syntax of this configuration file,
# see the file kconfig-language.txt in the NuttX tools repository.
#

config EXAMPLES_IPLITE
	tristate "\"Hello, World!\" example"
	default n
	---help---
		Enable the \"Hello, World!\" example

if EXAMPLES_IPLITE

config EXAMPLES_IPLITE_PROGNAME
	string "Program name"
	default "iplite"
	---help---
		This is the name of the program that will be used when the NSH ELF
		program is installed.

config EXAMPLES_IPLITE_PRIORITY
	int "Hello task priority"
	default 100

config EXAMPLES_IPLITE_STACKSIZE
	int "Hello stack size"
	default DEFAULT_TASK_STACKSIZE

endif
```
